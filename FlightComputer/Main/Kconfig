## FlightComputer/Main/Kconfig
```kconfig
#
# For a description of the syntax of this file, see the Kconfig scripting
# language documentation.
#

menuconfig FLIGHTCOMPUTER_MAIN
    bool "Main Flight Computer Application"
    default n
    ---help---
        Enable the main Flight Computer application entry point. This
        application is responsible for initializing the system and
        starting all other flight tasks.

if FLIGHTCOMPUTER_MAIN

config FLIGHTCOMPUTER_MAIN_PROGNAME
    string "Program name"
    default "FlightComputer_main"
    ---help---
        This is the name of the program that will be used when the NSH ELF
        program is installed.

config FLIGHTCOMPUTER_MAIN_PRIORITY
    int "Main task priority"
    default 100

config FLIGHTCOMPUTER_MAIN_STACKSIZE
    int "Main task stack size"
    default 2048

endif
```

## FlightComputer/SensorPackage/Kconfig
```kconfig
menuconfig FLIGHTCOMPUTER_SENSORPACKAGE
        bool "Flight Computer Sensor Package"
        default n
        ---help---
                Enable the Flight Computer

if FLIGHTCOMPUTER_SENSORPACKAGE

config FLIGHTCOMPUTER_SENSORPACKAGE_PROGNAME
        string "Program name"
        default "FC_SensorPackage"
        ---help---
                This is the name of the program that will be used when the NSH ELF
                program is installed.

config FLIGHTCOMPUTER_SENSORPACKAGE_PRIORITY
        int "Sensor Package task priority"
        default 100

config FLIGHTCOMPUTER_SENSORPACKAGE_STACKSIZE
        int "Sensor Package stack size"
        default 2048

endif
```
